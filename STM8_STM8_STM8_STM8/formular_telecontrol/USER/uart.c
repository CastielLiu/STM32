/******************** (C) COPYRIGHT  风驰iCreate嵌入式开发工作室 ***************************

 * 文件名  ：uart.c
 * 描述    ：串口通信配置函数库     
 * 实验平台：iCreate STM8开发板
 * 寄存器版本  ：V1.0.0
 * 作者    ：ling_guansheng  QQ：779814207
 * 博客    ：
 *修改时间 ：2011-12-20
  iCreate STM8开发板硬件连接
    |--------------------|
    |  USART1_RX-PA4     |
    |  USART1_TX-PA5     |
    |--------------------|

****************************************************************************************/

#include "uart.h"
/**************************************************************************
 * 函数名：uart_conf
 * 描述  ：uart配置函数
 * 输入  ：无
 *
 * 输出  ：无
 * 返回  ：无 
 * 调用  ：外部调用 
 *************************************************************************/

//UART_CR1 0<<5 UART使能
//         0<<4 字长设置为8位  1<<4 9位
//         0<<3 空闲唤醒  1<<3 被地址标记唤醒
//         0<<2 禁用奇偶校验  1<<2  使能奇偶校验
//         0<<1 偶校验  1<<1 奇校验
//         0<<0 校验失败中断禁止  1<<0使能
/*
USRT_CR2   7             6               5         4             3        2         1           0
        发送中断使能，发送完成中断使能，收断使能，空闲中断， 发送使能，接收使能，接收唤醒，发送断开帧

UART_CR3    7           5     ：   4             3        2         1           0  
          保留  ， 停止位00一10二11一点五，  时钟使能  ，时钟极性
*/
void uart_conf(void)
{
    unsigned int baud_div=0;
    
    UART2_CR1 = (0<<4)|(0<<3)|(0<<2)|(0<<1)|(0<<0);   
    /*1位起始位 8位数据位 结束位由CR3设置 不使用奇偶校验 不使能奇偶校验中断*/
    UART2_CR2 = (0<<7)|(0<<6)|(1<<5)|(0<<4)|(1<<3)|(1<<2); 
    /*使能发送和接收 接收中断使能 禁止发送中断*/
    UART2_CR3 = (0<<6)|(0<<4)|(0<<3); /*设置1位停止位 不使能SCLK*/       
    
    //UART2_CR5 = (0<<2)|(0<<1);     
    /*使用智能卡模式需要设置的，基本上保持默认就行了 */ 
    
    /*设置波特率*/
    baud_div =HSIClockFreq/BaudRate;  /*求出分频因子*/
    UART2_BRR2 = baud_div & 0x0f;
    UART2_BRR2 |= ((baud_div & 0xf000) >> 8);
    UART2_BRR1 = ((baud_div & 0x0ff0) >> 4);    /*先给BRR2赋值 最后再设置BRR1*/
    
    UART2_CR1 |= (0<<5);         /*使能UART*/
    
    PD_DDR |=0x20; //PD5 输出
    PD_DDR &=0xbf; //PD6 输入
    PD_CR1 |=0x20;//PD5 推挽
    PD_CR1 &=0xbf;//PD6 浮空
    PD_CR2 |=0x20;//PD5 10M
    PD_CR2 &=0xbf; //PD6  禁用外部中断 
    PD_ODR |=0x20;  //PD5拉高

}
/**************************************************************************
 * 函数名：UART1_SendByte
 * 描述  ：uart发送一个字节
 * 输入  ：u8 data
 *
 * 输出  ：无
 * 返回  ：无 
 * 调用  ：外部调用 
 * 举例  ：UART1_SendByte('a')
 *************************************************************************/
void UART2_SendByte(u8 data)
{
    
    UART2_DR=data;
   /* Loop until the end of transmission */
   while (!(UART2_SR & 0x80));
}

/**********************************************************************************
 * 函数名：UART1_SendByte
 * 描述  ：uart发送字符串
 * 输入  ：u8* Data,u16 len
 *
 * 输出  ：无
 * 返回  ：无 
 * 调用  ：外部调用 
 * 举例  ：UART1_SendString("iCreate STM8开发板",sizeof("iCreate STM8开发板"))
 **********************************************************************************/
void UART2_SendString(u8* Data,u16 len)
{
  u16 i=0;
  for(;i<len;i++)
    UART2_SendByte(Data[i]);
  
}
/**********************************************************************************
 * 函数名：UART1_ReceiveByte
 * 描述  ：uart查询接收一个字节
 * 输入  ：无
 *
 * 输出  ：无
 * 返回  ：一个字节 
 * 调用  ：外部调用 
 * 举例  ：temp=UART1_ReceiveByte()
 **********************************************************************************/
u8 UART2_ReceiveByte(void)
{
     u8 USART2_RX_BUF; 
     while (!(UART2_SR & 0x20));
     USART2_RX_BUF=(uint8_t)UART2_DR;
     return  USART2_RX_BUF;
    
}


/***********************************************
 * 函数名：fputc
 * 描述  ：重定向c库函数printf到USART1
 * 输入  ：无
 * 输出  ：无
 * 调用  ：由printf调用
 ***********************************************/
int fputc(int ch, FILE *f)
{
 /*将Printf内容发往串口*/ 
  UART2_DR=(unsigned char)ch;
  while (!(UART2_SR & 0x80));
  return (ch);
}
/******************* (C) COPYRIGHT 风驰iCreate嵌入式开发工作室 *****END OF FILE****/

